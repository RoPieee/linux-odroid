/dts-v1/;
/plugin/;

#include <dt-bindings/gpio/meson-g12a-gpio.h>
#include <dt-bindings/gpio/gpio.h>
#include <dt-bindings/interrupt-controller/irq.h>

/ {
	fragment@0 {
		target = <&spicc0>;

		__overlay__ {
			status = "okay";
			#address-cells = <1>;
			#size-cells = <0>;

			ethernet0: w5500@0 {
				status = "okay";
				compatible = "wiznet,w5500";
				reg = <0>;
				spi-max-frequency = <30000000>;

				pinctrl-names = "default";
				pinctrl-0 = <&pinctrl_mikrobus1_int &pinctrl_mikrobus1_rst>;

				interrupt-parent = <&gpio_intc>;
				interrupts = <GPIOX_4 IRQ_TYPE_EDGE_FALLING>;

				irq-gpios = <&gpio GPIOX_4 GPIO_ACTIVE_LOW>;
				reset-gpios = <&gpio GPIOX_3 GPIO_ACTIVE_LOW>;
			};
		};
	};
};
